## components/debug/Kconfig
```kconfig
menu "MSG ouput disable"

config MSG_SILENT
    bool "Disable printf based Message ouput"
    default 0
    help
		Disable MSG output for the target <make monitor>
endmenu
```

## components/display/Kconfig
```kconfig
#menu "PreAmp configuration options"
	menu "I2C display configuration"

	config VOL_DISP_ADDR
	    	hex "I2C address of volume display"
		range 0x00 0x7F
		default 0x3C
		help
			I2C address in hex of the display used to show the volume level.

	config VOL_DISP_WIDTH
    	int "Pixel width of Display"
		range 0 128
		default 128
		help
			With in pixel of the display showing the current volume.

	 config VOL_DISP_HEIGHT
				int "Pixel height of Display"
			range 0 64
			default 64
			help
				Height in pixel of the display showing the current volume.

	config VOLRESETPIN
    	int "GPIO Number of Reset Pin, -1 if none."
		range -1 64
		default -1
		help
			GPIO pin for the hard reset pin. If the Display does not have one use -1.

	config INP_DISP_ADDR
	   	hex "I2C address of input display"
			range 0x00 0x7F
			default 0x3D
			help
					I2C address in hex of the display used to show the input source.

		config INP_DISP_WIDTH
	    	int "Pixel width of Display"
			range 0 128
			default 128
			help
				With in pixel of the display showing the current input source.

	 	config INP_DISP_HEIGHT
				int "Pixel height of Display"
				range 0 64
				default 64
				help
					Height in pixel of the display showing the current input source.

		config INPRESETPIN
		   	int "GPIO Number of Reset Pin, -1 if none."
			range -1 64
			default -1
			help
				GPIO pin for the hard reset pin. If the Display does not have one use -1.


	endmenu
#endmenu
```

## components/relais/Kconfig
```kconfig
menu "Relais GPIO Pins"

config RELAIS_GPIO_1
    int "Relais 1 GPIO number"
	range 0 34
	default 23
	help
		GPIO number (IOxx) for Relais on and off.

		Some GPIOs are used for other purposes (flash connections, etc.) and cannot be used.

		GPIOs 35-39 are input-only so cannot be used as outputs.


config RELAIS_GPIO_2
    int "Relais 2 GPIO number"
	range 0 34
	default 22
	help
		GPIO number (IOxx) for Relais on and off.

		Some GPIOs are used for other purposes (flash connections, etc.) and cannot be used.

		GPIOs 35-39 are input-only so cannot be used as outputs.

config RELAIS_GPIO_3
    int "Relais 3 GPIO number"
	range 0 34
	default 21
	help
		GPIO number (IOxx) for Relais on and off.

		Some GPIOs are used for other purposes (flash connections, etc.) and cannot be used.

		GPIOs 35-39 are input-only so cannot be used as outputs.

config RELAIS_GPIO_4
    int "Relais 4 GPIO number"
	range 0 34
	default 19
	help
		GPIO number (IOxx) for Relais on and off.

		Some GPIOs are used for other purposes (flash connections, etc.) and cannot be used.

		GPIOs 35-39 are input-only so cannot be used as outputs.

config RELAIS_GPIO_5
    int "Relais 5 GPIO number"
	range 0 34
	default 18
	help
		GPIO number (IOxx) for Relais on and off.

		Some GPIOs are used for other purposes (flash connections, etc.) and cannot be used.

		GPIOs 35-39 are input-only so cannot be used as outputs.

endmenu
```

## components/rotary/Kconfig
```kconfig
menu "Rotary encoder GPIO Pin assignment"

config PCNT0_PULSE_GPIO
    int "GPIO number for Pulsecounter 0 Clock"
	range 0 34
	default 12
	help
		GPIO number (IOxx) for Pulsecounter 0 Clock.

config PCNT0_CONTROL_GPIO
    int "GPIO number for Pulsecounter 0 Data Line"
	range 0 34
	default 14
	help
		GPIO number (IOxx) for Pulsecounter 0 Data Line.

config ENC0_SW_GPIO
    int "GPIO number for Pulsecounter 0 Switch"
	range 0 34
	default 13
	help
		GPIO number (IOxx) for Pulsecounter 0 Switch Button.

config PCNT1_PULSE_GPIO
    int "GPIO number for Pulsecounter 1 Clock"
	range 0 34
	default 27
	help
		GPIO number (IOxx) for Pulsecounter 1 Clock.

config PCNT1_CONTROL_GPIO
    int "GPIO number for Pulsecounter 1 Data Line"
	range 0 34
	default 27
	help
		GPIO number (IOxx) for Pulsecounter 1 Data Line.

config ENC1_SW_GPIO
    int "GPIO number for Pulsecounter 1 Switch"
	range 0 34
	default 25
	help
		GPIO number (IOxx) for Pulsecounter 1 Switch Button.



endmenu
```

## components/volume/Kconfig
```kconfig
#menu "PreAmp configuration options"
	menu "Volume I2C configuration"

	config I2C_SCL_VOL_IO
    	int "I2C_SCL_IO I2C Master clock pin"
		range 0 34
		default 19
		help
			GPIO number (IOxx) for I2C master clock.

			Some GPIOs are used for other purposes (flash connections, etc.) and cannot be used.

			GPIOs 35-39 are input-only so cannot be used as outputs.


	config I2C_SDA_VOL_IO
    	int "I2C_SDL_IO I2C Master data line pin"
		range 0 34
		default 18
		help
			GPIO number (IOxx) for I2C master data.

			Some GPIOs are used for other purposes (flash connections, etc.) and cannot be used.

			GPIOs 35-39 are input-only so cannot be used as outputs.

	config I2C_MASTER_VOL_NUM
    	int "I2C Master number"
		range 0 1
		default 1
		help
			I2C Master port number used for the volume control

	config I2C_MASTER_VOL_FREQ
    	int "I2C Master Frequency in Hz"
		range  100000 400000
		default 100000
		help
			I2C Master port Frequency in Hz. Usually 100000 Hz is considered standard mode.

	
	config ADG_U1_ADDR
    	hex "U1 ADDR for ADG slave 1 in HEX"
		range  0x00 0xFF
		default 0x4C
		help
			I2C slave adress for ADG U1.

	config ADG_U2_ADDR
    	hex "U2 ADDR for ADG slave 2 in HEX"
		range  0x00 0xFF
		default 0x4D
		help
			I2C slave adress for ADG U2.

	config ADG_U3_ADDR
    	hex "U1 ADDR for ADG slave 3 in HEX"
		range  0x00 0xFF
		default 0x4E
		help
			I2C slave adress for ADG U3.

	config MAX_VOL_STEPS
    	int "Maximum attenuation step count"
		range  1 48
		default 24
		help
			Step count that represents the maximum Volume.

	config MIN_VOL_STEPS
    	int "Minimum attenuation step count"
		range  1 48
		default 1
		help
			Step count that represents the minimum Volume.

	config MUTE_VOL_STEP
    	int "Mute attenuation step count"
		range  0 48
		default 0
		help
			Step count that represents the muted Volume.


	endmenu
#endmenu
```
